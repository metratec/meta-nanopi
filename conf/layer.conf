## conf/layer.conf
```bitbake
# We have a conf and classes directory, add to BBPATH
BBPATH .= ":${LAYERDIR}"

# We have a recipes-* directories, add to BBFILES
BBFILES += "${LAYERDIR}/recipes-*/*/*.bb \
	${LAYERDIR}/recipes-*/*/*.bbappend"

BBFILE_COLLECTIONS += "nanopi"
BBFILE_PATTERN_nanopi = "^${LAYERDIR}/"
BBFILE_PRIORITY_nanopi = "6"
```

## conf/machine/nanopi-neo-core.conf
```bitbake
#@TYPE: Machine
#@NAME: nanopi-neo-core

#@DESCRIPTION: Machine configuration for nanopi-neo2 systems

MACHINE_EXTRA_RRECOMMENDS = " kernel-modules kernel-devicetree"

EXTRA_IMAGEDEPENDS += "u-boot"

require conf/machine/include/sun8i.inc

PREFERRED_PROVIDER_virtual/kernel = "linux-sunxi"

KERNEL_IMAGETYPE = "zImage"
KERNEL_DEVICETREE = "sun8i-h3-nanopi-neo-core.dtb"
#KERNEL_EXTRA_ARGS += "LOADADDR=${UBOOT_ENTRYPOINT}"

#SPL_BINARY = "MLO"
#UBOOT_SUFFIX = "img"
UBOOT_MACHINE = "nanopi_h3_defconfig"

MACHINE_FEATURES_remove = "keyboard screen"

#IMAGE_BOOT_FILES ?= "u-boot.${UBOOT_SUFFIX} MLO"
#IMAGE_BOOT_FILES ?= "u-boot.${UBOOT_SUFFIX}"

BUILD_DESKTOP = "no"
```

## conf/machine/nanopi-neo2.conf
```bitbake
#@TYPE: Machine
#@NAME: nanopi-neo2

#@DESCRIPTION: Machine configuration for nanopi-neo2 systems


MACHINE_EXTRA_RRECOMMENDS = " kernel-modules kernel-devicetree"

EXTRA_IMAGEDEPENDS += "u-boot"

include conf/machine/include/arm/arch-armv8.inc
# FIXME: Cortex A53 might be available in Yocto versions > 2.2.
# Perhaps simply backport tune-cortexa53.inc.
#include conf/machine/include/tune-cortexa53.inc

IMAGE_FSTYPES += "tar.bz2 jffs2"
EXTRA_IMAGECMD_jffs2 = "-lnp "

SERIAL_CONSOLE = "115200 ttyO0"

PREFERRED_PROVIDER_virtual/kernel ?= "linux-sunxi"

KERNEL_IMAGETYPE = "Image"
KERNEL_DEVICETREE = "allwinner/sun50i-h5-nanopi-neo2.dtb"
KERNEL_EXTRA_ARGS += "LOADADDR=${UBOOT_ENTRYPOINT}"

#SPL_BINARY = "MLO"
UBOOT_SUFFIX = "img"
UBOOT_MACHINE = "nanopi_h5_defconfig"
UBOOT_ENTRYPOINT = "0x80008000"
UBOOT_LOADADDRESS = "0x80008000"

MACHINE_FEATURES = "usbgadget usbhost vfat"

#IMAGE_BOOT_FILES ?= "u-boot.${UBOOT_SUFFIX} MLO"
IMAGE_BOOT_FILES ?= "u-boot.${UBOOT_SUFFIX}"

IMAGE_CLASSES += "sdcard_image-sunxi"
```
